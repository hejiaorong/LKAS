AUTOSAR XML (schema 4-2-2)
package /LKAS_pkg/LKAS_imp
  swc implementation LKAS: programming-language=C, sw-version=1.14.1, used-code-generator=Embedded Coder 7.1 (R2018b) 24-May-2018, vendor-id=0, behavior=LKAS
    code-descriptors:
      code Code
        artifact-descriptors:
          short-label=LKAS_c, category=SWSRC
          short-label=LKAS_calib_c, category=SWSRC
          short-label=LKAS_data_c, category=SWSRC
          short-label=LKAS_h, category=SWHDR
          short-label=LKAS_private_h, category=SWHDR
          short-label=LKAS_types_h, category=SWHDR
          short-label=rtwtypes_h, category=SWHDR
    resource consumption RsrcCons_LKAS
