AUTOSAR XML (schema 4-2-2)
standard types defined: UInt16, UInt8, Float, uint16, float32, uint8
package /AUTOSAR/Services/Dcm
  range DC_UInt16: raw 0..65535
  range DC_UInt8: raw 0..255
  range DC_Float: raw -INF..INF
package /LKAS_pkg/LKAS_dt
  impl type T_M_Nm_Float32: category=VALUE, base-type=float32, range raw -INF..INF  # Nm (newton-meters (Nm))
package /LKAS_pkg/LKAS_dt/Ground
  88 x constant specification:
    LKA_CarWidth: value-spec=LKA_CarWidth:1.8
    LKA_SampleTime: value-spec=LKA_SampleTime:0.01
    LKA_StrRatio_C: value-spec=LKA_StrRatio_C:15.3
    LKA_Veh2CamL_C: value-spec=LKA_Veh2CamL_C:1.56
    LKA_Veh2CamW_C: value-spec=LKA_Veh2CamW_C:0.9
    LKA_WhlBaseL_C: value-spec=LKA_WhlBaseL_C:2.65
    LL_CompSWA_C: value-spec=LL_CompSWA_C:0
    LL_CrvtPrvwT_C: value-spec=LL_CrvtPrvwT_C:0.45
    LL_DesDvt_C: value-spec=LL_DesDvt_C:0.2
    LL_DvtComp_C: value-spec=LL_DvtComp_C:0
    LL_DvtPrvwT_C: value-spec=LL_DvtPrvwT_C:0.45
    LL_DvtSpdDet_vDvtSpdMin_C: value-spec=LL_DvtSpdDet_vDvtSpdMin_C:0
    LL_HdAgExT_C: value-spec=LL_HdAgExT_C:15
    LL_HdAgPrvwT_C: value-spec=LL_HdAgPrvwT_C:0.45
    LL_LAccMax_C: value-spec=LL_LAccMax_C:3
    LL_LAccRMax_C: value-spec=LL_LAccRMax_C:5
    LL_LDWS_SUPPRESS_HEADING: value-spec=LL_LDWS_SUPPRESS_HEADING:2
    LL_LDW_EarliestWarnLine_C: value-spec=LL_LDW_EarliestWarnLine_C:0.3
    LL_LDW_LatestWarnLine_C: value-spec=LL_LDW_LatestWarnLine_C:-0.4
    LL_LFClb_TFC_DiffCtlBalance: value-spec=LL_LFClb_TFC_DiffCtlBalance:0
    LL_LFClb_TFC_DiffCtrlMaxSWA: value-spec=LL_LFClb_TFC_DiffCtrlMaxSWA:20
    LL_LFClb_TFC_DiffCtrlRatio: value-spec=LL_LFClb_TFC_DiffCtrlRatio:400
    LL_LFClb_TFC_FfCtlRatio_C: value-spec=LL_LFClb_TFC_FfCtlRatio_C:1
    LL_LFClb_TFC_facmGainLutGain1_C: value-spec=LL_LFClb_TFC_facmGainLutGain1_C:40
    LL_LFClb_TFC_facmGainLutGain2_C: value-spec=LL_LFClb_TFC_facmGainLutGain2_C:40
    LL_LFClb_TFC_facmIntegRatio: value-spec=LL_LFClb_TFC_facmIntegRatio:0.002
    LL_LFClb_TFC_facmKlat_C: value-spec=LL_LFClb_TFC_facmKlat_C:-9
    LL_LFClb_TFC_phiIntegCtlMaxSWA_C: value-spec=LL_LFClb_TFC_phiIntegCtlMaxSWA_C:5
    LL_LFClb_TFC_tiKlatPrvwT_C: value-spec=LL_LFClb_TFC_tiKlatPrvwT_C:2
    LL_LFClb_TFC_vGainLutVehSpdLwr_C: value-spec=LL_LFClb_TFC_vGainLutVehSpdLwr_C:60
    LL_LFClb_TFC_vGainLutVehSpdUpr_C: value-spec=LL_LFClb_TFC_vGainLutVehSpdUpr_C:120
    LL_LKAExPrcs_ExitC0Dvt: value-spec=LL_LKAExPrcs_ExitC0Dvt:0.01
    LL_LKAExPrcs_ExitC0Swt: value-spec=LL_LKAExPrcs_ExitC0Swt:1
    LL_LKAExPrcs_tiExitTime1: value-spec=LL_LKAExPrcs_tiExitTime1:8
    LL_LKAExPrcs_tiExitTime2: value-spec=LL_LKAExPrcs_tiExitTime2:4
    LL_LKAExPrcs_tiExitTime3: value-spec=LL_LKAExPrcs_tiExitTime3:0.2
    LL_LKASWASyn_M0: value-spec=LL_LKASWASyn_M0:0.4
    LL_LKASWASyn_M1: value-spec=LL_LKASWASyn_M1:0.8
    LL_LKASWASyn_M2: value-spec=LL_LKASWASyn_M2:0.3
    LL_LKASWASyn_M3K: value-spec=LL_LKASWASyn_M3K:0.2
    LL_LKASWASyn_SWAaddMax: value-spec=LL_LKASWASyn_SWAaddMax:8
    LL_LKASWASyn_T2: value-spec=LL_LKASWASyn_T2:4
    LL_LKASWASyn_TrqMax: value-spec=LL_LKASWASyn_TrqMax:1.5
    LL_LKASWASyn_TrqSwaAddSwt: value-spec=LL_LKASWASyn_TrqSwaAddSwt:0
    LL_LKASWASyn_TrqSwaRateDiff: value-spec=LL_LKASWASyn_TrqSwaRateDiff:-0.2
    LL_LKASWASyn_tiTrqSwaRtTime: value-spec=LL_LKASWASyn_tiTrqSwaRtTime:0.2
    LL_LKASWASyn_tiTrqSwaTime: value-spec=LL_LKASWASyn_tiTrqSwaTime:0.3
    LL_LKAS_OUT_OF_CONTROL_LAT_VEL: value-spec=LL_LKAS_OUT_OF_CONTROL_LAT_VEL:1.5
    LL_LKAS_OUT_OF_CONTROL_TTLC: value-spec=LL_LKAS_OUT_OF_CONTROL_TTLC:0.3
    LL_LKA_EarliestWarnLine_C: value-spec=LL_LKA_EarliestWarnLine_C:0.3
    LL_LKA_LatestWarnLine_C: value-spec=LL_LKA_LatestWarnLine_C:-0.5
    LL_LSpdCompT_C: value-spec=LL_LSpdCompT_C:0.4
    LL_MAX_DELAY_EPSSTAR_TIME: value-spec=LL_MAX_DELAY_EPSSTAR_TIME:0.5
    LL_MAX_DRIVER_TORQUE_DISABLE: value-spec=LL_MAX_DRIVER_TORQUE_DISABLE:2.25
    LL_MAX_DRIVER_TORQUE_ENABLE: value-spec=LL_MAX_DRIVER_TORQUE_ENABLE:3
    LL_MAX_LANE_WIDTH_DISABLE: value-spec=LL_MAX_LANE_WIDTH_DISABLE:5.5
    LL_MAX_LANE_WIDTH_ENABLE: value-spec=LL_MAX_LANE_WIDTH_ENABLE:5.4
    LL_MAX_LAT_ACC_DISABLE: value-spec=LL_MAX_LAT_ACC_DISABLE:3.5
    LL_MAX_LAT_ACC_ENABLE: value-spec=LL_MAX_LAT_ACC_ENABLE:3
    LL_MAX_LDWS_SPEED_DISABLE: value-spec=LL_MAX_LDWS_SPEED_DISABLE:150
    LL_MAX_LDWS_SPEED_ENABLE: value-spec=LL_MAX_LDWS_SPEED_ENABLE:140
    LL_MAX_LKAS_SPEED_DISABLE: value-spec=LL_MAX_LKAS_SPEED_DISABLE:150
    LL_MAX_LKAS_SPEED_ENABLE: value-spec=LL_MAX_LKAS_SPEED_ENABLE:140
    LL_MAX_LONG_ACC_DISABLE: value-spec=LL_MAX_LONG_ACC_DISABLE:3.5
    LL_MAX_LONG_ACC_ENABLE: value-spec=LL_MAX_LONG_ACC_ENABLE:3
    LL_MAX_LONG_DECEL_DISABLE: value-spec=LL_MAX_LONG_DECEL_DISABLE:2.5
    LL_MAX_LONG_DECEL_ENABLE: value-spec=LL_MAX_LONG_DECEL_ENABLE:2
    LL_MAX_STEER_ANGLE_DISABLE: value-spec=LL_MAX_STEER_ANGLE_DISABLE:70
    LL_MAX_STEER_ANGLE_ENABLE: value-spec=LL_MAX_STEER_ANGLE_ENABLE:60
    LL_MAX_STEER_SPEED_DISABLE: value-spec=LL_MAX_STEER_SPEED_DISABLE:5000
    LL_MAX_STEER_SPEED_ENABLE: value-spec=LL_MAX_STEER_SPEED_ENABLE:5000
    LL_MAX_SYSTEM_CURVATURE_DISABLE: value-spec=LL_MAX_SYSTEM_CURVATURE_DISABLE:0.0055
    LL_MAX_SYSTEM_CURVATURE_ENABLE: value-spec=LL_MAX_SYSTEM_CURVATURE_ENABLE:0.0045
    LL_MIN_LANE_WIDTH_DISABLE: value-spec=LL_MIN_LANE_WIDTH_DISABLE:2.4
    LL_MIN_LANE_WIDTH_ENABLE: value-spec=LL_MIN_LANE_WIDTH_ENABLE:2.5
    LL_MIN_LKAS_SPEED_DISABLE: value-spec=LL_MIN_LKAS_SPEED_DISABLE:55
    LL_MIN_LKAS_SPEED_ENABLE: value-spec=LL_MIN_LKAS_SPEED_ENABLE:60
    LL_Max_LDWS_Warning_Time: value-spec=LL_Max_LDWS_Warning_Time:5
    LL_NomTAhd_C: value-spec=LL_NomTAhd_C:0.2
    LL_ThresDet_lDvtThresLwrLDW: value-spec=LL_ThresDet_lDvtThresLwrLDW:0.15
    LL_ThresDet_lDvtThresLwrLKA: value-spec=LL_ThresDet_lDvtThresLwrLKA:0.3
    LL_ThresDet_lDvtThresUprLDW: value-spec=LL_ThresDet_lDvtThresUprLDW:0.3
    LL_ThresDet_lDvtThresUprLKA: value-spec=LL_ThresDet_lDvtThresUprLKA:0.6
    LL_ThresDet_tiTTLCThresLDW: value-spec=LL_ThresDet_tiTTLCThresLDW:0.75
    LL_ThresDet_tiTTLCThresLKA: value-spec=LL_ThresDet_tiTTLCThresLKA:1.5
    LL_TkOvStChk_tiTDelTime: value-spec=LL_TkOvStChk_tiTDelTime:2
    LL_TkOvStChk_tiTrqChkT: value-spec=LL_TkOvStChk_tiTrqChkT:0.1
    LL_lStpLngth_C: value-spec=LL_lStpLngth_C:5
package /LKAS_pkg/LKAS_dt/SwAddrMethods
  sw addr method CODE: section-type=CODE
  sw addr method CONST: section-type=CONST
  sw addr method VAR: section-type=VAR
