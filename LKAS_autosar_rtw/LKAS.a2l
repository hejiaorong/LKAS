/******************************************************************************
* ASAP2 file: LKAS.a2l
* Code generation for model "LKAS".
* Model version : 1.14
* Simulink Coder version : 9.0 (R2018b) 24-May-2018
* C source code generated on : Fri Aug 21 16:33:42 2020
* Target selection: autosar.tlc
* Embedded hardware selection: Intel->x86-64 (Windows64)
* Code generation objectives: Unspecified
* Validation result: Not run
* (add additional file header information here)
******************************************************************************/ ASAP2_VERSION 1 31
/* Version 1.31 */
/begin PROJECT ProjectName "Project Comment Goes Here"
/begin HEADER "Header Comments go here" /end HEADER
/begin MODULE ModuleName "Module Comment Goes Here"
/begin MOD_PAR "MOD PAR Comment Goes Here" /end MOD_PAR
/begin MOD_COMMON "Mod Common Comment Here" BYTE_ORDER MSB_LAST /end MOD_COMMON
/begin RECORD_LAYOUT Scalar_BOOLEAN FNC_VALUES 1 UBYTE COLUMN_DIR DIRECT /end RECORD_LAYOUT
/begin RECORD_LAYOUT Scalar_UBYTE FNC_VALUES 1 UBYTE COLUMN_DIR DIRECT /end RECORD_LAYOUT
/begin RECORD_LAYOUT Scalar_BYTE FNC_VALUES 1 SBYTE COLUMN_DIR DIRECT /end RECORD_LAYOUT
/begin RECORD_LAYOUT Scalar_UWORD FNC_VALUES 1 UWORD COLUMN_DIR DIRECT /end RECORD_LAYOUT
/begin RECORD_LAYOUT Scalar_SWORD FNC_VALUES 1 SWORD COLUMN_DIR DIRECT /end RECORD_LAYOUT
/begin RECORD_LAYOUT Scalar_ULONG FNC_VALUES 1 ULONG COLUMN_DIR DIRECT /end RECORD_LAYOUT
/begin RECORD_LAYOUT Scalar_LONG FNC_VALUES 1 SLONG COLUMN_DIR DIRECT /end RECORD_LAYOUT
/begin RECORD_LAYOUT Scalar_FLOAT32_IEEE FNC_VALUES 1 FLOAT32_IEEE COLUMN_DIR DIRECT /end RECORD_LAYOUT
/begin RECORD_LAYOUT Scalar_FLOAT64_IEEE FNC_VALUES 1 FLOAT64_IEEE COLUMN_DIR DIRECT /end RECORD_LAYOUT
/begin RECORD_LAYOUT Lookup1D_BOOLEAN FNC_VALUES 1 UBYTE COLUMN_DIR DIRECT /end RECORD_LAYOUT
/begin RECORD_LAYOUT Lookup1D_X_BOOLEAN AXIS_PTS_X 1 UBYTE INDEX_INCR DIRECT /end RECORD_LAYOUT
/begin RECORD_LAYOUT Lookup1D_BYTE FNC_VALUES 1 SBYTE COLUMN_DIR DIRECT /end RECORD_LAYOUT
/begin RECORD_LAYOUT Lookup1D_X_BYTE AXIS_PTS_X 1 SBYTE INDEX_INCR DIRECT /end RECORD_LAYOUT
/begin RECORD_LAYOUT Lookup1D_UBYTE FNC_VALUES 1 UBYTE COLUMN_DIR DIRECT /end RECORD_LAYOUT
/begin RECORD_LAYOUT Lookup1D_X_UBYTE AXIS_PTS_X 1 UBYTE INDEX_INCR DIRECT /end RECORD_LAYOUT
/begin RECORD_LAYOUT Lookup1D_UWORD FNC_VALUES 1 UWORD COLUMN_DIR DIRECT /end RECORD_LAYOUT
/begin RECORD_LAYOUT Lookup1D_X_UWORD AXIS_PTS_X 1 UWORD INDEX_INCR DIRECT /end RECORD_LAYOUT
/begin RECORD_LAYOUT Lookup1D_WORD FNC_VALUES 1 SWORD COLUMN_DIR DIRECT /end RECORD_LAYOUT
/begin RECORD_LAYOUT Lookup1D_X_WORD AXIS_PTS_X 1 SWORD INDEX_INCR DIRECT /end RECORD_LAYOUT
/begin RECORD_LAYOUT Lookup1D_ULONG FNC_VALUES 1 ULONG COLUMN_DIR DIRECT /end RECORD_LAYOUT
/begin RECORD_LAYOUT Lookup1D_X_ULONG AXIS_PTS_X 1 ULONG INDEX_INCR DIRECT /end RECORD_LAYOUT
/begin RECORD_LAYOUT Lookup1D_SLONG FNC_VALUES 1 SLONG COLUMN_DIR DIRECT /end RECORD_LAYOUT
/begin RECORD_LAYOUT Lookup1D_X_LONG AXIS_PTS_X 1 SLONG INDEX_INCR DIRECT /end RECORD_LAYOUT
/begin RECORD_LAYOUT Lookup1D_FLOAT32_IEEE FNC_VALUES 1 FLOAT32_IEEE COLUMN_DIR DIRECT /end RECORD_LAYOUT
/begin RECORD_LAYOUT Lookup1D_X_FLOAT32_IEEE AXIS_PTS_X 1 FLOAT32_IEEE INDEX_INCR DIRECT /end RECORD_LAYOUT
/begin RECORD_LAYOUT Lookup1D_FLOAT64_IEEE FNC_VALUES 1 FLOAT64_IEEE COLUMN_DIR DIRECT /end RECORD_LAYOUT
/begin RECORD_LAYOUT Lookup1D_X_FLOAT64_IEEE AXIS_PTS_X 1 FLOAT64_IEEE INDEX_INCR DIRECT /end RECORD_LAYOUT
/begin RECORD_LAYOUT Lookup2D_BOOLEAN FNC_VALUES 1 UBYTE COLUMN_DIR DIRECT /end RECORD_LAYOUT
/begin RECORD_LAYOUT Lookup2D_X_BOOLEAN AXIS_PTS_X 1 UBYTE INDEX_INCR DIRECT /end RECORD_LAYOUT
/begin RECORD_LAYOUT Lookup2D_UBYTE FNC_VALUES 1 UBYTE COLUMN_DIR DIRECT /end RECORD_LAYOUT
/begin RECORD_LAYOUT Lookup2D_X_UBYTE AXIS_PTS_X 1 UBYTE INDEX_INCR DIRECT /end RECORD_LAYOUT
/begin RECORD_LAYOUT Lookup2D_BYTE FNC_VALUES 1 SBYTE COLUMN_DIR DIRECT /end RECORD_LAYOUT
/begin RECORD_LAYOUT Lookup2D_X_BYTE AXIS_PTS_X 1 SBYTE INDEX_INCR DIRECT /end RECORD_LAYOUT
/begin RECORD_LAYOUT Lookup2D_UWORD FNC_VALUES 1 UWORD COLUMN_DIR DIRECT /end RECORD_LAYOUT
/begin RECORD_LAYOUT Lookup2D_X_UWORD AXIS_PTS_X 1 UWORD INDEX_INCR DIRECT /end RECORD_LAYOUT
/begin RECORD_LAYOUT Lookup2D_WORD FNC_VALUES 1 SWORD COLUMN_DIR DIRECT /end RECORD_LAYOUT
/begin RECORD_LAYOUT Lookup2D_X_WORD AXIS_PTS_X 1 SWORD INDEX_INCR DIRECT /end RECORD_LAYOUT
/begin RECORD_LAYOUT Lookup2D_ULONG FNC_VALUES 1 ULONG COLUMN_DIR DIRECT /end RECORD_LAYOUT
/begin RECORD_LAYOUT Lookup2D_X_ULONG AXIS_PTS_X 1 ULONG INDEX_INCR DIRECT /end RECORD_LAYOUT
/begin RECORD_LAYOUT Lookup2D_LONG FNC_VALUES 1 SLONG COLUMN_DIR DIRECT /end RECORD_LAYOUT
/begin RECORD_LAYOUT Lookup2D_X_LONG AXIS_PTS_X 1 SLONG INDEX_INCR DIRECT /end RECORD_LAYOUT
/begin RECORD_LAYOUT Lookup2D_FLOAT32_IEEE FNC_VALUES 1 FLOAT32_IEEE COLUMN_DIR DIRECT /end RECORD_LAYOUT
/begin RECORD_LAYOUT Lookup2D_X_FLOAT32_IEEE AXIS_PTS_X 1 FLOAT32_IEEE INDEX_INCR DIRECT /end RECORD_LAYOUT
/begin RECORD_LAYOUT Lookup2D_FLOAT64_IEEE FNC_VALUES 1 FLOAT64_IEEE COLUMN_DIR DIRECT /end RECORD_LAYOUT
/begin RECORD_LAYOUT Lookup2D_X_FLOAT64_IEEE AXIS_PTS_X 1 FLOAT64_IEEE INDEX_INCR DIRECT /end RECORD_LAYOUT
/begin CHARACTERISTIC LKA_CarWidth "" VALUE 0x0000 /* @ECU_Address@LKA_CarWidth@ */ Scalar_FLOAT32_IEEE 0 LKAS_CM_single -3.4E+38 3.4E+38 /end CHARACTERISTIC
/begin CHARACTERISTIC LKA_SampleTime "" VALUE 0x0000 /* @ECU_Address@LKA_SampleTime@ */ Scalar_FLOAT32_IEEE 0 LKAS_CM_single -3.4E+38 3.4E+38 /end CHARACTERISTIC
/begin CHARACTERISTIC LKA_StrRatio_C "" VALUE 0x0000 /* @ECU_Address@LKA_StrRatio_C@ */ Scalar_FLOAT32_IEEE 0 LKAS_CM_single -3.4E+38 3.4E+38 /end CHARACTERISTIC
/begin CHARACTERISTIC LKA_Veh2CamL_C "" VALUE 0x0000 /* @ECU_Address@LKA_Veh2CamL_C@ */ Scalar_FLOAT32_IEEE 0 LKAS_CM_single -3.4E+38 3.4E+38 /end CHARACTERISTIC
/begin CHARACTERISTIC LKA_Veh2CamW_C "" VALUE 0x0000 /* @ECU_Address@LKA_Veh2CamW_C@ */ Scalar_FLOAT32_IEEE 0 LKAS_CM_single -3.4E+38 3.4E+38 /end CHARACTERISTIC
/begin CHARACTERISTIC LKA_WhlBaseL_C "" VALUE 0x0000 /* @ECU_Address@LKA_WhlBaseL_C@ */ Scalar_FLOAT32_IEEE 0 LKAS_CM_single -3.4E+38 3.4E+38 /end CHARACTERISTIC
/begin CHARACTERISTIC LL_CompSWA_C "" VALUE 0x0000 /* @ECU_Address@LL_CompSWA_C@ */ Scalar_FLOAT32_IEEE 0 LKAS_CM_single -3.4E+38 3.4E+38 /end CHARACTERISTIC
/begin CHARACTERISTIC LL_CrvtPrvwT_C "" VALUE 0x0000 /* @ECU_Address@LL_CrvtPrvwT_C@ */ Scalar_FLOAT32_IEEE 0 LKAS_CM_single -3.4E+38 3.4E+38 /end CHARACTERISTIC
/begin CHARACTERISTIC LL_DesDvt_C "" VALUE 0x0000 /* @ECU_Address@LL_DesDvt_C@ */ Scalar_FLOAT32_IEEE 0 LKAS_CM_single -3.4E+38 3.4E+38 /end CHARACTERISTIC
/begin CHARACTERISTIC LL_DvtComp_C "" VALUE 0x0000 /* @ECU_Address@LL_DvtComp_C@ */ Scalar_FLOAT32_IEEE 0 LKAS_CM_single -3.4E+38 3.4E+38 /end CHARACTERISTIC
/begin CHARACTERISTIC LL_DvtPrvwT_C "" VALUE 0x0000 /* @ECU_Address@LL_DvtPrvwT_C@ */ Scalar_FLOAT32_IEEE 0 LKAS_CM_single -3.4E+38 3.4E+38 /end CHARACTERISTIC
/begin CHARACTERISTIC LL_DvtSpdDet_vDvtSpdMin_C "" VALUE 0x0000 /* @ECU_Address@LL_DvtSpdDet_vDvtSpdMin_C@ */ Scalar_FLOAT32_IEEE 0 LKAS_CM_single -3.4E+38 3.4E+38 /end CHARACTERISTIC
/begin CHARACTERISTIC LL_HdAgExT_C "" VALUE 0x0000 /* @ECU_Address@LL_HdAgExT_C@ */ Scalar_FLOAT32_IEEE 0 LKAS_CM_single -3.4E+38 3.4E+38 /end CHARACTERISTIC
/begin CHARACTERISTIC LL_HdAgPrvwT_C "" VALUE 0x0000 /* @ECU_Address@LL_HdAgPrvwT_C@ */ Scalar_FLOAT32_IEEE 0 LKAS_CM_single -3.4E+38 3.4E+38 /end CHARACTERISTIC
/begin CHARACTERISTIC LL_LAccMax_C "" VALUE 0x0000 /* @ECU_Address@LL_LAccMax_C@ */ Scalar_FLOAT32_IEEE 0 LKAS_CM_single -3.4E+38 3.4E+38 /end CHARACTERISTIC
/begin CHARACTERISTIC LL_LAccRMax_C "" VALUE 0x0000 /* @ECU_Address@LL_LAccRMax_C@ */ Scalar_FLOAT32_IEEE 0 LKAS_CM_single -3.4E+38 3.4E+38 /end CHARACTERISTIC
/begin CHARACTERISTIC LL_LDWS_SUPPRESS_HEADING "" VALUE 0x0000 /* @ECU_Address@LL_LDWS_SUPPRESS_HEADING@ */ Scalar_FLOAT32_IEEE 0 LKAS_CM_single -3.4E+38 3.4E+38 /end CHARACTERISTIC
/begin CHARACTERISTIC LL_LDW_EarliestWarnLine_C "" VALUE 0x0000 /* @ECU_Address@LL_LDW_EarliestWarnLine_C@ */ Scalar_FLOAT32_IEEE 0 LKAS_CM_single -3.4E+38 3.4E+38 /end CHARACTERISTIC
/begin CHARACTERISTIC LL_LDW_LatestWarnLine_C "" VALUE 0x0000 /* @ECU_Address@LL_LDW_LatestWarnLine_C@ */ Scalar_FLOAT32_IEEE 0 LKAS_CM_single -3.4E+38 3.4E+38 /end CHARACTERISTIC
/begin CHARACTERISTIC LL_LFClb_TFC_DiffCtlBalance "" VALUE 0x0000 /* @ECU_Address@LL_LFClb_TFC_DiffCtlBalance@ */ Scalar_FLOAT32_IEEE 0 LKAS_CM_single -3.4E+38 3.4E+38 /end CHARACTERISTIC
/begin CHARACTERISTIC LL_LFClb_TFC_DiffCtrlMaxSWA "" VALUE 0x0000 /* @ECU_Address@LL_LFClb_TFC_DiffCtrlMaxSWA@ */ Scalar_FLOAT32_IEEE 0 LKAS_CM_single -3.4E+38 3.4E+38 /end CHARACTERISTIC
/begin CHARACTERISTIC LL_LFClb_TFC_DiffCtrlRatio "" VALUE 0x0000 /* @ECU_Address@LL_LFClb_TFC_DiffCtrlRatio@ */ Scalar_FLOAT32_IEEE 0 LKAS_CM_single -3.4E+38 3.4E+38 /end CHARACTERISTIC
/begin CHARACTERISTIC LL_LFClb_TFC_FfCtlRatio_C "" VALUE 0x0000 /* @ECU_Address@LL_LFClb_TFC_FfCtlRatio_C@ */ Scalar_FLOAT32_IEEE 0 LKAS_CM_single -3.4E+38 3.4E+38 /end CHARACTERISTIC
/begin CHARACTERISTIC LL_LFClb_TFC_facmGainLutGain1_C "" VALUE 0x0000 /* @ECU_Address@LL_LFClb_TFC_facmGainLutGain1_C@ */ Scalar_FLOAT32_IEEE 0 LKAS_CM_single -3.4E+38 3.4E+38 /end CHARACTERISTIC
/begin CHARACTERISTIC LL_LFClb_TFC_facmGainLutGain2_C "" VALUE 0x0000 /* @ECU_Address@LL_LFClb_TFC_facmGainLutGain2_C@ */ Scalar_FLOAT32_IEEE 0 LKAS_CM_single -3.4E+38 3.4E+38 /end CHARACTERISTIC
/begin CHARACTERISTIC LL_LFClb_TFC_facmIntegRatio "" VALUE 0x0000 /* @ECU_Address@LL_LFClb_TFC_facmIntegRatio@ */ Scalar_FLOAT32_IEEE 0 LKAS_CM_single -3.4E+38 3.4E+38 /end CHARACTERISTIC
/begin CHARACTERISTIC LL_LFClb_TFC_facmKlat_C "" VALUE 0x0000 /* @ECU_Address@LL_LFClb_TFC_facmKlat_C@ */ Scalar_FLOAT32_IEEE 0 LKAS_CM_single -3.4E+38 3.4E+38 /end CHARACTERISTIC
/begin CHARACTERISTIC LL_LFClb_TFC_phiIntegCtlMaxSWA_C "" VALUE 0x0000 /* @ECU_Address@LL_LFClb_TFC_phiIntegCtlMaxSWA_C@ */ Scalar_FLOAT32_IEEE 0 LKAS_CM_single -3.4E+38 3.4E+38 /end CHARACTERISTIC
/begin CHARACTERISTIC LL_LFClb_TFC_tiKlatPrvwT_C "" VALUE 0x0000 /* @ECU_Address@LL_LFClb_TFC_tiKlatPrvwT_C@ */ Scalar_FLOAT32_IEEE 0 LKAS_CM_single -3.4E+38 3.4E+38 /end CHARACTERISTIC
/begin CHARACTERISTIC LL_LFClb_TFC_vGainLutVehSpdLwr_C "" VALUE 0x0000 /* @ECU_Address@LL_LFClb_TFC_vGainLutVehSpdLwr_C@ */ Scalar_FLOAT32_IEEE 0 LKAS_CM_single -3.4E+38 3.4E+38 /end CHARACTERISTIC
/begin CHARACTERISTIC LL_LFClb_TFC_vGainLutVehSpdUpr_C "" VALUE 0x0000 /* @ECU_Address@LL_LFClb_TFC_vGainLutVehSpdUpr_C@ */ Scalar_FLOAT32_IEEE 0 LKAS_CM_single -3.4E+38 3.4E+38 /end CHARACTERISTIC
/begin CHARACTERISTIC LL_LKAExPrcs_ExitC0Dvt "" VALUE 0x0000 /* @ECU_Address@LL_LKAExPrcs_ExitC0Dvt@ */ Scalar_FLOAT32_IEEE 0 LKAS_CM_single -3.4E+38 3.4E+38 /end CHARACTERISTIC
/begin CHARACTERISTIC LL_LKAExPrcs_ExitC0Swt "" VALUE 0x0000 /* @ECU_Address@LL_LKAExPrcs_ExitC0Swt@ */ Scalar_FLOAT32_IEEE 0 LKAS_CM_single -3.4E+38 3.4E+38 /end CHARACTERISTIC
/begin CHARACTERISTIC LL_LKAExPrcs_tiExitTime1 "" VALUE 0x0000 /* @ECU_Address@LL_LKAExPrcs_tiExitTime1@ */ Scalar_FLOAT32_IEEE 0 LKAS_CM_single -3.4E+38 3.4E+38 /end CHARACTERISTIC
/begin CHARACTERISTIC LL_LKAExPrcs_tiExitTime2 "" VALUE 0x0000 /* @ECU_Address@LL_LKAExPrcs_tiExitTime2@ */ Scalar_FLOAT32_IEEE 0 LKAS_CM_single -3.4E+38 3.4E+38 /end CHARACTERISTIC
/begin CHARACTERISTIC LL_LKAExPrcs_tiExitTime3 "" VALUE 0x0000 /* @ECU_Address@LL_LKAExPrcs_tiExitTime3@ */ Scalar_FLOAT32_IEEE 0 LKAS_CM_single -3.4E+38 3.4E+38 /end CHARACTERISTIC
/begin CHARACTERISTIC LL_LKASWASyn_M0 "" VALUE 0x0000 /* @ECU_Address@LL_LKASWASyn_M0@ */ Scalar_FLOAT32_IEEE 0 LKAS_CM_single -3.4E+38 3.4E+38 /end CHARACTERISTIC
/begin CHARACTERISTIC LL_LKASWASyn_M1 "" VALUE 0x0000 /* @ECU_Address@LL_LKASWASyn_M1@ */ Scalar_FLOAT32_IEEE 0 LKAS_CM_single -3.4E+38 3.4E+38 /end CHARACTERISTIC
/begin CHARACTERISTIC LL_LKASWASyn_M2 "" VALUE 0x0000 /* @ECU_Address@LL_LKASWASyn_M2@ */ Scalar_FLOAT32_IEEE 0 LKAS_CM_single -3.4E+38 3.4E+38 /end CHARACTERISTIC
/begin CHARACTERISTIC LL_LKASWASyn_M3K "" VALUE 0x0000 /* @ECU_Address@LL_LKASWASyn_M3K@ */ Scalar_FLOAT32_IEEE 0 LKAS_CM_single -3.4E+38 3.4E+38 /end CHARACTERISTIC
/begin CHARACTERISTIC LL_LKASWASyn_SWAaddMax "" VALUE 0x0000 /* @ECU_Address@LL_LKASWASyn_SWAaddMax@ */ Scalar_FLOAT32_IEEE 0 LKAS_CM_single -3.4E+38 3.4E+38 /end CHARACTERISTIC
/begin CHARACTERISTIC LL_LKASWASyn_T2 "" VALUE 0x0000 /* @ECU_Address@LL_LKASWASyn_T2@ */ Scalar_FLOAT32_IEEE 0 LKAS_CM_single -3.4E+38 3.4E+38 /end CHARACTERISTIC
/begin CHARACTERISTIC LL_LKASWASyn_TrqMax "" VALUE 0x0000 /* @ECU_Address@LL_LKASWASyn_TrqMax@ */ Scalar_FLOAT32_IEEE 0 LKAS_CM_single -3.4E+38 3.4E+38 /end CHARACTERISTIC
/begin CHARACTERISTIC LL_LKASWASyn_TrqSwaAddSwt "" VALUE 0x0000 /* @ECU_Address@LL_LKASWASyn_TrqSwaAddSwt@ */ Scalar_FLOAT32_IEEE 0 LKAS_CM_single -3.4E+38 3.4E+38 /end CHARACTERISTIC
/begin CHARACTERISTIC LL_LKASWASyn_TrqSwaRateDiff "" VALUE 0x0000 /* @ECU_Address@LL_LKASWASyn_TrqSwaRateDiff@ */ Scalar_FLOAT32_IEEE 0 LKAS_CM_single -3.4E+38 3.4E+38 /end CHARACTERISTIC
/begin CHARACTERISTIC LL_LKASWASyn_tiTrqSwaRtTime "" VALUE 0x0000 /* @ECU_Address@LL_LKASWASyn_tiTrqSwaRtTime@ */ Scalar_FLOAT32_IEEE 0 LKAS_CM_single -3.4E+38 3.4E+38 /end CHARACTERISTIC
/begin CHARACTERISTIC LL_LKASWASyn_tiTrqSwaTime "" VALUE 0x0000 /* @ECU_Address@LL_LKASWASyn_tiTrqSwaTime@ */ Scalar_FLOAT32_IEEE 0 LKAS_CM_single -3.4E+38 3.4E+38 /end CHARACTERISTIC
/begin CHARACTERISTIC LL_LKAS_OUT_OF_CONTROL_LAT_VEL "" VALUE 0x0000 /* @ECU_Address@LL_LKAS_OUT_OF_CONTROL_LAT_VEL@ */ Scalar_FLOAT32_IEEE 0 LKAS_CM_single -3.4E+38 3.4E+38 /end CHARACTERISTIC
/begin CHARACTERISTIC LL_LKAS_OUT_OF_CONTROL_TTLC "" VALUE 0x0000 /* @ECU_Address@LL_LKAS_OUT_OF_CONTROL_TTLC@ */ Scalar_FLOAT32_IEEE 0 LKAS_CM_single -3.4E+38 3.4E+38 /end CHARACTERISTIC
/begin CHARACTERISTIC LL_LKA_EarliestWarnLine_C "" VALUE 0x0000 /* @ECU_Address@LL_LKA_EarliestWarnLine_C@ */ Scalar_FLOAT32_IEEE 0 LKAS_CM_single -3.4E+38 3.4E+38 /end CHARACTERISTIC
/begin CHARACTERISTIC LL_LKA_LatestWarnLine_C "" VALUE 0x0000 /* @ECU_Address@LL_LKA_LatestWarnLine_C@ */ Scalar_FLOAT32_IEEE 0 LKAS_CM_single -3.4E+38 3.4E+38 /end CHARACTERISTIC
/begin CHARACTERISTIC LL_LSpdCompT_C "" VALUE 0x0000 /* @ECU_Address@LL_LSpdCompT_C@ */ Scalar_FLOAT32_IEEE 0 LKAS_CM_single -3.4E+38 3.4E+38 /end CHARACTERISTIC
/begin CHARACTERISTIC LL_MAX_DELAY_EPSSTAR_TIME "" VALUE 0x0000 /* @ECU_Address@LL_MAX_DELAY_EPSSTAR_TIME@ */ Scalar_FLOAT32_IEEE 0 LKAS_CM_single -3.4E+38 3.4E+38 /end CHARACTERISTIC
/begin CHARACTERISTIC LL_MAX_DRIVER_TORQUE_DISABLE "" VALUE 0x0000 /* @ECU_Address@LL_MAX_DRIVER_TORQUE_DISABLE@ */ Scalar_FLOAT32_IEEE 0 LKAS_CM_single -3.4E+38 3.4E+38 /end CHARACTERISTIC
/begin CHARACTERISTIC LL_MAX_DRIVER_TORQUE_ENABLE "" VALUE 0x0000 /* @ECU_Address@LL_MAX_DRIVER_TORQUE_ENABLE@ */ Scalar_FLOAT32_IEEE 0 LKAS_CM_single -3.4E+38 3.4E+38 /end CHARACTERISTIC
/begin CHARACTERISTIC LL_MAX_LANE_WIDTH_DISABLE "" VALUE 0x0000 /* @ECU_Address@LL_MAX_LANE_WIDTH_DISABLE@ */ Scalar_FLOAT32_IEEE 0 LKAS_CM_single -3.4E+38 3.4E+38 /end CHARACTERISTIC
/begin CHARACTERISTIC LL_MAX_LANE_WIDTH_ENABLE "" VALUE 0x0000 /* @ECU_Address@LL_MAX_LANE_WIDTH_ENABLE@ */ Scalar_FLOAT32_IEEE 0 LKAS_CM_single -3.4E+38 3.4E+38 /end CHARACTERISTIC
/begin CHARACTERISTIC LL_MAX_LAT_ACC_DISABLE "" VALUE 0x0000 /* @ECU_Address@LL_MAX_LAT_ACC_DISABLE@ */ Scalar_FLOAT32_IEEE 0 LKAS_CM_single -3.4E+38 3.4E+38 /end CHARACTERISTIC
/begin CHARACTERISTIC LL_MAX_LAT_ACC_ENABLE "" VALUE 0x0000 /* @ECU_Address@LL_MAX_LAT_ACC_ENABLE@ */ Scalar_FLOAT32_IEEE 0 LKAS_CM_single -3.4E+38 3.4E+38 /end CHARACTERISTIC
/begin CHARACTERISTIC LL_MAX_LDWS_SPEED_DISABLE "" VALUE 0x0000 /* @ECU_Address@LL_MAX_LDWS_SPEED_DISABLE@ */ Scalar_FLOAT32_IEEE 0 LKAS_CM_single -3.4E+38 3.4E+38 /end CHARACTERISTIC
/begin CHARACTERISTIC LL_MAX_LDWS_SPEED_ENABLE "" VALUE 0x0000 /* @ECU_Address@LL_MAX_LDWS_SPEED_ENABLE@ */ Scalar_FLOAT32_IEEE 0 LKAS_CM_single -3.4E+38 3.4E+38 /end CHARACTERISTIC
/begin CHARACTERISTIC LL_MAX_LKAS_SPEED_DISABLE "" VALUE 0x0000 /* @ECU_Address@LL_MAX_LKAS_SPEED_DISABLE@ */ Scalar_FLOAT32_IEEE 0 LKAS_CM_single -3.4E+38 3.4E+38 /end CHARACTERISTIC
/begin CHARACTERISTIC LL_MAX_LKAS_SPEED_ENABLE "" VALUE 0x0000 /* @ECU_Address@LL_MAX_LKAS_SPEED_ENABLE@ */ Scalar_FLOAT32_IEEE 0 LKAS_CM_single -3.4E+38 3.4E+38 /end CHARACTERISTIC
/begin CHARACTERISTIC LL_MAX_LONG_ACC_DISABLE "" VALUE 0x0000 /* @ECU_Address@LL_MAX_LONG_ACC_DISABLE@ */ Scalar_FLOAT32_IEEE 0 LKAS_CM_single -3.4E+38 3.4E+38 /end CHARACTERISTIC
/begin CHARACTERISTIC LL_MAX_LONG_ACC_ENABLE "" VALUE 0x0000 /* @ECU_Address@LL_MAX_LONG_ACC_ENABLE@ */ Scalar_FLOAT32_IEEE 0 LKAS_CM_single -3.4E+38 3.4E+38 /end CHARACTERISTIC
/begin CHARACTERISTIC LL_MAX_LONG_DECEL_DISABLE "" VALUE 0x0000 /* @ECU_Address@LL_MAX_LONG_DECEL_DISABLE@ */ Scalar_FLOAT32_IEEE 0 LKAS_CM_single -3.4E+38 3.4E+38 /end CHARACTERISTIC
/begin CHARACTERISTIC LL_MAX_LONG_DECEL_ENABLE "" VALUE 0x0000 /* @ECU_Address@LL_MAX_LONG_DECEL_ENABLE@ */ Scalar_FLOAT32_IEEE 0 LKAS_CM_single -3.4E+38 3.4E+38 /end CHARACTERISTIC
/begin CHARACTERISTIC LL_MAX_STEER_ANGLE_DISABLE "" VALUE 0x0000 /* @ECU_Address@LL_MAX_STEER_ANGLE_DISABLE@ */ Scalar_FLOAT32_IEEE 0 LKAS_CM_single -3.4E+38 3.4E+38 /end CHARACTERISTIC
/begin CHARACTERISTIC LL_MAX_STEER_ANGLE_ENABLE "" VALUE 0x0000 /* @ECU_Address@LL_MAX_STEER_ANGLE_ENABLE@ */ Scalar_FLOAT32_IEEE 0 LKAS_CM_single -3.4E+38 3.4E+38 /end CHARACTERISTIC
/begin CHARACTERISTIC LL_MAX_STEER_SPEED_DISABLE "" VALUE 0x0000 /* @ECU_Address@LL_MAX_STEER_SPEED_DISABLE@ */ Scalar_FLOAT32_IEEE 0 LKAS_CM_single -3.4E+38 3.4E+38 /end CHARACTERISTIC
/begin CHARACTERISTIC LL_MAX_STEER_SPEED_ENABLE "" VALUE 0x0000 /* @ECU_Address@LL_MAX_STEER_SPEED_ENABLE@ */ Scalar_FLOAT32_IEEE 0 LKAS_CM_single -3.4E+38 3.4E+38 /end CHARACTERISTIC
/begin CHARACTERISTIC LL_MAX_SYSTEM_CURVATURE_DISABLE "" VALUE 0x0000 /* @ECU_Address@LL_MAX_SYSTEM_CURVATURE_DISABLE@ */ Scalar_FLOAT32_IEEE 0 LKAS_CM_single -3.4E+38 3.4E+38 /end CHARACTERISTIC
/begin CHARACTERISTIC LL_MAX_SYSTEM_CURVATURE_ENABLE "" VALUE 0x0000 /* @ECU_Address@LL_MAX_SYSTEM_CURVATURE_ENABLE@ */ Scalar_FLOAT32_IEEE 0 LKAS_CM_single -3.4E+38 3.4E+38 /end CHARACTERISTIC
/begin CHARACTERISTIC LL_MIN_LANE_WIDTH_DISABLE "" VALUE 0x0000 /* @ECU_Address@LL_MIN_LANE_WIDTH_DISABLE@ */ Scalar_FLOAT32_IEEE 0 LKAS_CM_single -3.4E+38 3.4E+38 /end CHARACTERISTIC
/begin CHARACTERISTIC LL_MIN_LANE_WIDTH_ENABLE "" VALUE 0x0000 /* @ECU_Address@LL_MIN_LANE_WIDTH_ENABLE@ */ Scalar_FLOAT32_IEEE 0 LKAS_CM_single -3.4E+38 3.4E+38 /end CHARACTERISTIC
/begin CHARACTERISTIC LL_MIN_LKAS_SPEED_DISABLE "" VALUE 0x0000 /* @ECU_Address@LL_MIN_LKAS_SPEED_DISABLE@ */ Scalar_FLOAT32_IEEE 0 LKAS_CM_single -3.4E+38 3.4E+38 /end CHARACTERISTIC
/begin CHARACTERISTIC LL_MIN_LKAS_SPEED_ENABLE "" VALUE 0x0000 /* @ECU_Address@LL_MIN_LKAS_SPEED_ENABLE@ */ Scalar_FLOAT32_IEEE 0 LKAS_CM_single -3.4E+38 3.4E+38 /end CHARACTERISTIC
/begin CHARACTERISTIC LL_Max_LDWS_Warning_Time "" VALUE 0x0000 /* @ECU_Address@LL_Max_LDWS_Warning_Time@ */ Scalar_FLOAT32_IEEE 0 LKAS_CM_single -3.4E+38 3.4E+38 /end CHARACTERISTIC
/begin CHARACTERISTIC LL_NomTAhd_C "" VALUE 0x0000 /* @ECU_Address@LL_NomTAhd_C@ */ Scalar_FLOAT32_IEEE 0 LKAS_CM_single -3.4E+38 3.4E+38 /end CHARACTERISTIC
/begin CHARACTERISTIC LL_ThresDet_lDvtThresLwrLDW "" VALUE 0x0000 /* @ECU_Address@LL_ThresDet_lDvtThresLwrLDW@ */ Scalar_FLOAT32_IEEE 0 LKAS_CM_single -3.4E+38 3.4E+38 /end CHARACTERISTIC
/begin CHARACTERISTIC LL_ThresDet_lDvtThresLwrLKA "" VALUE 0x0000 /* @ECU_Address@LL_ThresDet_lDvtThresLwrLKA@ */ Scalar_FLOAT32_IEEE 0 LKAS_CM_single -3.4E+38 3.4E+38 /end CHARACTERISTIC
/begin CHARACTERISTIC LL_ThresDet_lDvtThresUprLDW "" VALUE 0x0000 /* @ECU_Address@LL_ThresDet_lDvtThresUprLDW@ */ Scalar_FLOAT32_IEEE 0 LKAS_CM_single -3.4E+38 3.4E+38 /end CHARACTERISTIC
/begin CHARACTERISTIC LL_ThresDet_lDvtThresUprLKA "" VALUE 0x0000 /* @ECU_Address@LL_ThresDet_lDvtThresUprLKA@ */ Scalar_FLOAT32_IEEE 0 LKAS_CM_single -3.4E+38 3.4E+38 /end CHARACTERISTIC
/begin CHARACTERISTIC LL_ThresDet_tiTTLCThresLDW "" VALUE 0x0000 /* @ECU_Address@LL_ThresDet_tiTTLCThresLDW@ */ Scalar_FLOAT32_IEEE 0 LKAS_CM_single -3.4E+38 3.4E+38 /end CHARACTERISTIC
/begin CHARACTERISTIC LL_ThresDet_tiTTLCThresLKA "" VALUE 0x0000 /* @ECU_Address@LL_ThresDet_tiTTLCThresLKA@ */ Scalar_FLOAT32_IEEE 0 LKAS_CM_single -3.4E+38 3.4E+38 /end CHARACTERISTIC
/begin CHARACTERISTIC LL_TkOvStChk_tiTDelTime "" VALUE 0x0000 /* @ECU_Address@LL_TkOvStChk_tiTDelTime@ */ Scalar_FLOAT32_IEEE 0 LKAS_CM_single -3.4E+38 3.4E+38 /end CHARACTERISTIC
/begin CHARACTERISTIC LL_TkOvStChk_tiTrqChkT "" VALUE 0x0000 /* @ECU_Address@LL_TkOvStChk_tiTrqChkT@ */ Scalar_FLOAT32_IEEE 0 LKAS_CM_single -3.4E+38 3.4E+38 /end CHARACTERISTIC
/begin CHARACTERISTIC LL_lStpLngth_C "" VALUE 0x0000 /* @ECU_Address@LL_lStpLngth_C@ */ Scalar_FLOAT32_IEEE 0 LKAS_CM_single -3.4E+38 3.4E+38 /end CHARACTERISTIC
/begin COMPU_METHOD /* Name of CompuMethod */ LKAS_CM_single "Q = V" /* Conversion Type */ RAT_FUNC /* Format */ "%8.6" /* Units */ "" /* Coefficients */ COEFFS 0 1 0 0 0 1 /end COMPU_METHOD
/begin GROUP LKAS "LKAS" /* Root */ ROOT /begin SUB_GROUP Root_LKAS /end SUB_GROUP /end GROUP
/begin GROUP Root_LKAS "LKAS/LKAS" /begin SUB_GROUP S1_LLClb /end SUB_GROUP /end GROUP
/begin GROUP S1_LLClb "LKAS/LKAS/LLClb" /begin SUB_GROUP S3_ConstantClb S3_LDWClb S3_LKAClb S3_LLSMConClb /end SUB_GROUP /end GROUP
/begin GROUP S3_ConstantClb "LKAS/LKAS/LLClb/ConstantClb"
 /begin REF_CHARACTERISTIC LKA_CarWidth LKA_SampleTime LKA_StrRatio_C LKA_Veh2CamL_C LKA_Veh2CamW_C LKA_WhlBaseL_C /end REF_CHARACTERISTIC
/end GROUP
/begin GROUP S3_LDWClb "LKAS/LKAS/LLClb/LDWClb" /begin REF_CHARACTERISTIC LL_LDWS_SUPPRESS_HEADING /end REF_CHARACTERISTIC /end GROUP
/begin GROUP S3_LKAClb "LKAS/LKAS/LLClb/LKAClb"
 /begin REF_CHARACTERISTIC LL_CompSWA_C LL_CrvtPrvwT_C LL_DesDvt_C LL_DvtComp_C LL_DvtPrvwT_C LL_HdAgExT_C LL_HdAgPrvwT_C LL_LAccMax_C LL_LAccRMax_C LL_LFClb_TFC_DiffCtlBalance LL_LFClb_TFC_DiffCtrlMaxSWA LL_LFClb_TFC_DiffCtrlRatio LL_LFClb_TFC_FfCtlRatio_C LL_LFClb_TFC_facmGainLutGain1_C LL_LFClb_TFC_facmGainLutGain2_C LL_LFClb_TFC_facmIntegRatio LL_LFClb_TFC_facmKlat_C LL_LFClb_TFC_phiIntegCtlMaxSWA_C LL_LFClb_TFC_tiKlatPrvwT_C LL_LFClb_TFC_vGainLutVehSpdLwr_C LL_LFClb_TFC_vGainLutVehSpdUpr_C LL_LKAExPrcs_ExitC0Dvt LL_LKAExPrcs_ExitC0Swt LL_LKAExPrcs_tiExitTime1 LL_LKAExPrcs_tiExitTime2 LL_LKAExPrcs_tiExitTime3 LL_LKASWASyn_M0 LL_LKASWASyn_M1 LL_LKASWASyn_M2 LL_LKASWASyn_M3K LL_LKASWASyn_SWAaddMax LL_LKASWASyn_T2 LL_LKASWASyn_TrqMax LL_LKASWASyn_TrqSwaAddSwt LL_LKASWASyn_TrqSwaRateDiff LL_LKASWASyn_tiTrqSwaRtTime LL_LKASWASyn_tiTrqSwaTime LL_LSpdCompT_C LL_NomTAhd_C LL_lStpLngth_C /end REF_CHARACTERISTIC
/end GROUP
/begin GROUP S3_LLSMConClb "LKAS/LKAS/LLClb/LLSMConClb"
 /begin REF_CHARACTERISTIC LL_DvtComp_C LL_DvtSpdDet_vDvtSpdMin_C LL_LDW_EarliestWarnLine_C LL_LDW_LatestWarnLine_C LL_LKAS_OUT_OF_CONTROL_LAT_VEL LL_LKAS_OUT_OF_CONTROL_TTLC LL_LKA_EarliestWarnLine_C LL_LKA_LatestWarnLine_C LL_MAX_DELAY_EPSSTAR_TIME LL_MAX_DRIVER_TORQUE_DISABLE LL_MAX_DRIVER_TORQUE_ENABLE LL_MAX_LANE_WIDTH_DISABLE LL_MAX_LANE_WIDTH_ENABLE LL_MAX_LAT_ACC_DISABLE LL_MAX_LAT_ACC_ENABLE LL_MAX_LDWS_SPEED_DISABLE LL_MAX_LDWS_SPEED_ENABLE LL_MAX_LKAS_SPEED_DISABLE LL_MAX_LKAS_SPEED_ENABLE LL_MAX_LONG_ACC_DISABLE LL_MAX_LONG_ACC_ENABLE LL_MAX_LONG_DECEL_DISABLE LL_MAX_LONG_DECEL_ENABLE LL_MAX_STEER_ANGLE_DISABLE LL_MAX_STEER_ANGLE_ENABLE LL_MAX_STEER_SPEED_DISABLE LL_MAX_STEER_SPEED_ENABLE LL_MAX_SYSTEM_CURVATURE_DISABLE LL_MAX_SYSTEM_CURVATURE_ENABLE LL_MIN_LANE_WIDTH_DISABLE LL_MIN_LANE_WIDTH_ENABLE LL_MIN_LKAS_SPEED_DISABLE LL_MIN_LKAS_SPEED_ENABLE LL_Max_LDWS_Warning_Time LL_ThresDet_lDvtThresLwrLDW LL_ThresDet_lDvtThresLwrLKA LL_ThresDet_lDvtThresUprLDW LL_ThresDet_lDvtThresUprLKA LL_ThresDet_tiTTLCThresLDW LL_ThresDet_tiTTLCThresLKA LL_TkOvStChk_tiTDelTime LL_TkOvStChk_tiTrqChkT /end REF_CHARACTERISTIC
/end GROUP
/end MODULE
/end PROJECT
/* (add any file trailer comments here) */
/* EOF LKAS.a2l */
