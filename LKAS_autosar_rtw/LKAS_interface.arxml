AUTOSAR XML (schema 4-2-2)
package /LKAS_pkg/LKAS_if
  136 x sender receiver interface:
    IMAPve_d_LKA_Main_Switch
      data IMAPve_d_LKA_Main_Switch: category=VALUE, sw-calibration-access=READ-ONLY, type=UInt16
    IMAPve_d_LKA_Mode
      data IMAPve_d_LKA_Mode: category=VALUE, sw-calibration-access=READ-ONLY, type=UInt16
    IMAPve_d_LDW_Warn_Mode
      data IMAPve_d_LDW_Warn_Mode: category=VALUE, sw-calibration-access=READ-ONLY, type=UInt16
    IMAPve_d_EPS_LKA_State
      data IMAPve_d_EPS_LKA_State: category=VALUE, sw-calibration-access=READ-ONLY, type=UInt16
    IMAPve_g_EPS_SW_Trq
      data IMAPve_g_EPS_SW_Trq: category=VALUE, sw-calibration-access=READ-ONLY, type=T_M_Nm_Float32
    IMAPve_d_EPS_Error_State
      data IMAPve_d_EPS_Error_State: category=VALUE, sw-calibration-access=READ-ONLY, type=UInt16
    IMAPve_d_EPS_Trq_State
      data IMAPve_d_EPS_Trq_State: category=VALUE, sw-calibration-access=READ-ONLY, type=UInt16
    IMAPve_d_SAS_Clb_State
      data IMAPve_d_SAS_Clb_State: category=VALUE, sw-calibration-access=READ-ONLY, type=UInt16
    IMAPve_d_SAS_Trim_State
      data IMAPve_d_SAS_Trim_State: category=VALUE, sw-calibration-access=READ-ONLY, type=UInt16
    IMAPve_d_EPS_TrqLim_State
      data IMAPve_d_EPS_TrqLim_State: category=VALUE, sw-calibration-access=READ-ONLY, type=UInt16
    IMAPve_g_EPS_LKA_Current
      data IMAPve_g_EPS_LKA_Current: category=VALUE, sw-calibration-access=READ-ONLY, type=T_M_Nm_Float32
    IMAPve_g_ESC_LatAcc
      data IMAPve_g_ESC_LatAcc: category=VALUE, sw-calibration-access=READ-ONLY, type=T_M_Nm_Float32
    IMAPve_d_ESC_LatAcc_Valid
      data IMAPve_d_ESC_LatAcc_Valid: category=VALUE, sw-calibration-access=READ-ONLY, type=UInt16
    IMAPve_g_ESC_YawRate
      data IMAPve_g_ESC_YawRate: category=VALUE, sw-calibration-access=READ-ONLY, type=T_M_Nm_Float32
    IMAPve_d_ESC_YawRate_Valid
      data IMAPve_d_ESC_YawRate_Valid: category=VALUE, sw-calibration-access=READ-ONLY, type=UInt16
    IMAPve_g_ESC_UnYawRate
      data IMAPve_g_ESC_UnYawRate: category=VALUE, sw-calibration-access=READ-ONLY, type=T_M_Nm_Float32
    IMAPve_g_ESC_VehSpd
      data IMAPve_g_ESC_VehSpd: category=VALUE, sw-calibration-access=READ-ONLY, type=T_M_Nm_Float32
    IMAPve_g_ESC_LonAcc
      data IMAPve_g_ESC_LonAcc: category=VALUE, sw-calibration-access=READ-ONLY, type=T_M_Nm_Float32
    IMAPve_d_ESC_LonAcc_Valid
      data IMAPve_d_ESC_LonAcc_Valid: category=VALUE, sw-calibration-access=READ-ONLY, type=UInt16
    IMAPve_g_ESC_Brake_Press
      data IMAPve_g_ESC_Brake_Press: category=VALUE, sw-calibration-access=READ-ONLY, type=T_M_Nm_Float32
    IMAPve_g_SW_Angle
      data IMAPve_g_SW_Angle: category=VALUE, sw-calibration-access=READ-ONLY, type=T_M_Nm_Float32
    IMAPve_g_SW_Angle_Speed
      data IMAPve_g_SW_Angle_Speed: category=VALUE, sw-calibration-access=READ-ONLY, type=T_M_Nm_Float32
    IMAPve_d_BCM_HazardLamp
      data IMAPve_d_BCM_HazardLamp: category=VALUE, sw-calibration-access=READ-ONLY, type=UInt16
    IMAPve_d_BCM_Left_Light
      data IMAPve_d_BCM_Left_Light: category=VALUE, sw-calibration-access=READ-ONLY, type=UInt16
    IMAPve_d_BCM_Right_Light
      data IMAPve_d_BCM_Right_Light: category=VALUE, sw-calibration-access=READ-ONLY, type=UInt16
    IMAPve_g_EMS_RealPedal
      data IMAPve_g_EMS_RealPedal: category=VALUE, sw-calibration-access=READ-ONLY, type=T_M_Nm_Float32
    IMAPve_d_TCU_Actual_Gear
      data IMAPve_d_TCU_Actual_Gear: category=VALUE, sw-calibration-access=READ-ONLY, type=UInt16
    IMAPve_d_SWS_Fault_Code
      data IMAPve_d_SWS_Fault_Code: category=VALUE, sw-calibration-access=READ-ONLY, type=UInt16
    IMAPve_d_SWS_Failure_Status
      data IMAPve_d_SWS_Failure_Status: category=VALUE, sw-calibration-access=READ-ONLY, type=UInt16
    IMAPve_d_ESC_VehSpd_Valid
      data IMAPve_d_ESC_VehSpd_Valid: category=VALUE, sw-calibration-access=READ-ONLY, type=UInt16
    IMAPve_d_EPS_Steer_Hold_State
      data IMAPve_d_EPS_Steer_Hold_State: category=VALUE, sw-calibration-access=READ-ONLY, type=UInt16
    IMAPve_d_ORI_Lane_Valid
      data IMAPve_d_ORI_Lane_Valid: category=VALUE, sw-calibration-access=READ-ONLY, type=UInt16
    IMAPve_d_ORI_Lane_ConsArea
      data IMAPve_d_ORI_Lane_ConsArea: category=VALUE, sw-calibration-access=READ-ONLY, type=UInt16
    IMAPve_d_ORI_Lane_RoadType
      data IMAPve_d_ORI_Lane_RoadType: category=VALUE, sw-calibration-access=READ-ONLY, type=UInt16
    IMAPve_g_ORI_L0_C3
      data IMAPve_g_ORI_L0_C3: category=VALUE, sw-calibration-access=READ-ONLY, type=T_M_Nm_Float32
    IMAPve_g_ORI_L0_C2
      data IMAPve_g_ORI_L0_C2: category=VALUE, sw-calibration-access=READ-ONLY, type=T_M_Nm_Float32
    IMAPve_g_ORI_L0_C1
      data IMAPve_g_ORI_L0_C1: category=VALUE, sw-calibration-access=READ-ONLY, type=T_M_Nm_Float32
    IMAPve_g_ORI_L0_C0
      data IMAPve_g_ORI_L0_C0: category=VALUE, sw-calibration-access=READ-ONLY, type=T_M_Nm_Float32
    IMAPve_d_ORI_L0_Q
      data IMAPve_d_ORI_L0_Q: category=VALUE, sw-calibration-access=READ-ONLY, type=UInt16
    IMAPve_d_ORI_L0_Type
      data IMAPve_d_ORI_L0_Type: category=VALUE, sw-calibration-access=READ-ONLY, type=UInt16
    IMAPve_g_ORI_L0_VR
      data IMAPve_g_ORI_L0_VR: category=VALUE, sw-calibration-access=READ-ONLY, type=T_M_Nm_Float32
    IMAPve_g_ORI_L0_TLC
      data IMAPve_g_ORI_L0_TLC: category=VALUE, sw-calibration-access=READ-ONLY, type=T_M_Nm_Float32
    IMAPve_g_ORI_L0_W
      data IMAPve_g_ORI_L0_W: category=VALUE, sw-calibration-access=READ-ONLY, type=T_M_Nm_Float32
    IMAPve_d_ORI_L0_LC
      data IMAPve_d_ORI_L0_LC: category=VALUE, sw-calibration-access=READ-ONLY, type=UInt16
    IMAPve_g_ORI_L1_C3
      data IMAPve_g_ORI_L1_C3: category=VALUE, sw-calibration-access=READ-ONLY, type=T_M_Nm_Float32
    IMAPve_g_ORI_L1_C2
      data IMAPve_g_ORI_L1_C2: category=VALUE, sw-calibration-access=READ-ONLY, type=T_M_Nm_Float32
    IMAPve_g_ORI_L1_C1
      data IMAPve_g_ORI_L1_C1: category=VALUE, sw-calibration-access=READ-ONLY, type=T_M_Nm_Float32
    IMAPve_g_ORI_L1_C0
      data IMAPve_g_ORI_L1_C0: category=VALUE, sw-calibration-access=READ-ONLY, type=T_M_Nm_Float32
    IMAPve_d_ORI_L1_Q
      data IMAPve_d_ORI_L1_Q: category=VALUE, sw-calibration-access=READ-ONLY, type=UInt16
    IMAPve_d_ORI_L1_Type
      data IMAPve_d_ORI_L1_Type: category=VALUE, sw-calibration-access=READ-ONLY, type=UInt16
    IMAPve_g_ORI_L1_VR
      data IMAPve_g_ORI_L1_VR: category=VALUE, sw-calibration-access=READ-ONLY, type=T_M_Nm_Float32
    IMAPve_g_ORI_L1_TLC
      data IMAPve_g_ORI_L1_TLC: category=VALUE, sw-calibration-access=READ-ONLY, type=T_M_Nm_Float32
    IMAPve_g_ORI_L1_W
      data IMAPve_g_ORI_L1_W: category=VALUE, sw-calibration-access=READ-ONLY, type=T_M_Nm_Float32
    IMAPve_d_ORI_L1_LC
      data IMAPve_d_ORI_L1_LC: category=VALUE, sw-calibration-access=READ-ONLY, type=UInt16
    IMAPve_g_ORI_R0_C3
      data IMAPve_g_ORI_R0_C3: category=VALUE, sw-calibration-access=READ-ONLY, type=T_M_Nm_Float32
    IMAPve_g_ORI_R0_C2
      data IMAPve_g_ORI_R0_C2: category=VALUE, sw-calibration-access=READ-ONLY, type=T_M_Nm_Float32
    IMAPve_g_ORI_R0_C1
      data IMAPve_g_ORI_R0_C1: category=VALUE, sw-calibration-access=READ-ONLY, type=T_M_Nm_Float32
    IMAPve_g_ORI_R0_C0
      data IMAPve_g_ORI_R0_C0: category=VALUE, sw-calibration-access=READ-ONLY, type=T_M_Nm_Float32
    IMAPve_d_ORI_R0_Q
      data IMAPve_d_ORI_R0_Q: category=VALUE, sw-calibration-access=READ-ONLY, type=UInt16
    IMAPve_d_ORI_R0_LT
      data IMAPve_d_ORI_R0_LT: category=VALUE, sw-calibration-access=READ-ONLY, type=UInt16
    IMAPve_g_ORI_R0_VR
      data IMAPve_g_ORI_R0_VR: category=VALUE, sw-calibration-access=READ-ONLY, type=T_M_Nm_Float32
    IMAPve_g_ORI_R0_TLC
      data IMAPve_g_ORI_R0_TLC: category=VALUE, sw-calibration-access=READ-ONLY, type=T_M_Nm_Float32
    IMAPve_g_ORI_R0_W
      data IMAPve_g_ORI_R0_W: category=VALUE, sw-calibration-access=READ-ONLY, type=T_M_Nm_Float32
    IMAPve_d_ORI_R0_LC
      data IMAPve_d_ORI_R0_LC: category=VALUE, sw-calibration-access=READ-ONLY, type=UInt16
    IMAPve_g_ORI_R1_C3
      data IMAPve_g_ORI_R1_C3: category=VALUE, sw-calibration-access=READ-ONLY, type=T_M_Nm_Float32
    IMAPve_g_ORI_R1_C2
      data IMAPve_g_ORI_R1_C2: category=VALUE, sw-calibration-access=READ-ONLY, type=T_M_Nm_Float32
    IMAPve_g_ORI_R1_C1
      data IMAPve_g_ORI_R1_C1: category=VALUE, sw-calibration-access=READ-ONLY, type=T_M_Nm_Float32
    IMAPve_g_ORI_R1_C0
      data IMAPve_g_ORI_R1_C0: category=VALUE, sw-calibration-access=READ-ONLY, type=T_M_Nm_Float32
    IMAPve_d_ORI_R1_Q
      data IMAPve_d_ORI_R1_Q: category=VALUE, sw-calibration-access=READ-ONLY, type=UInt16
    IMAPve_d_ORI_R1_LT
      data IMAPve_d_ORI_R1_LT: category=VALUE, sw-calibration-access=READ-ONLY, type=UInt16
    IMAPve_g_ORI_R1_VR
      data IMAPve_g_ORI_R1_VR: category=VALUE, sw-calibration-access=READ-ONLY, type=T_M_Nm_Float32
    IMAPve_g_ORI_R1_TLC
      data IMAPve_g_ORI_R1_TLC: category=VALUE, sw-calibration-access=READ-ONLY, type=T_M_Nm_Float32
    IMAPve_g_ORI_R1_W
      data IMAPve_g_ORI_R1_W: category=VALUE, sw-calibration-access=READ-ONLY, type=T_M_Nm_Float32
    IMAPve_d_ORI_R1_LC
      data IMAPve_d_ORI_R1_LC: category=VALUE, sw-calibration-access=READ-ONLY, type=UInt16
    IMAPve_d_Sensor_Status
      data IMAPve_d_Sensor_Status: category=VALUE, sw-calibration-access=READ-ONLY, type=UInt16
    IMAPve_d_Fusion_Status
      data IMAPve_d_Fusion_Status: category=VALUE, sw-calibration-access=READ-ONLY, type=UInt16
    IMAPve_d_Lane_Valid
      data IMAPve_d_Lane_Valid: category=VALUE, sw-calibration-access=READ-ONLY, type=UInt16
    IMAPve_d_Road_Type
      data IMAPve_d_Road_Type: category=VALUE, sw-calibration-access=READ-ONLY, type=UInt16
    IMAPve_d_ConsArea
      data IMAPve_d_ConsArea: category=VALUE, sw-calibration-access=READ-ONLY, type=UInt16
    IMAPve_g_L0_C0
      data IMAPve_g_L0_C0: category=VALUE, sw-calibration-access=READ-ONLY, type=T_M_Nm_Float32
    IMAPve_g_L0_C1
      data IMAPve_g_L0_C1: category=VALUE, sw-calibration-access=READ-ONLY, type=T_M_Nm_Float32
    IMAPve_g_L0_C2
      data IMAPve_g_L0_C2: category=VALUE, sw-calibration-access=READ-ONLY, type=T_M_Nm_Float32
    IMAPve_g_L0_C3
      data IMAPve_g_L0_C3: category=VALUE, sw-calibration-access=READ-ONLY, type=T_M_Nm_Float32
    IMAPve_g_L0_VR
      data IMAPve_g_L0_VR: category=VALUE, sw-calibration-access=READ-ONLY, type=T_M_Nm_Float32
    IMAPve_d_L0_Q
      data IMAPve_d_L0_Q: category=VALUE, sw-calibration-access=READ-ONLY, type=UInt16
    IMAPve_d_L0_Type
      data IMAPve_d_L0_Type: category=VALUE, sw-calibration-access=READ-ONLY, type=UInt16
    IMAPve_g_L0_Confidence
      data IMAPve_g_L0_Confidence: category=VALUE, sw-calibration-access=READ-ONLY, type=T_M_Nm_Float32
    IMAPve_g_L0_W
      data IMAPve_g_L0_W: category=VALUE, sw-calibration-access=READ-ONLY, type=T_M_Nm_Float32
    IMAPve_g_L0_TLC
      data IMAPve_g_L0_TLC: category=VALUE, sw-calibration-access=READ-ONLY, type=T_M_Nm_Float32
    IMAPve_d_L0_LC
      data IMAPve_d_L0_LC: category=VALUE, sw-calibration-access=READ-ONLY, type=UInt16
    IMAPve_g_R0_C0
      data IMAPve_g_R0_C0: category=VALUE, sw-calibration-access=READ-ONLY, type=T_M_Nm_Float32
    IMAPve_g_R0_C1
      data IMAPve_g_R0_C1: category=VALUE, sw-calibration-access=READ-ONLY, type=T_M_Nm_Float32
    IMAPve_g_R0_C2
      data IMAPve_g_R0_C2: category=VALUE, sw-calibration-access=READ-ONLY, type=T_M_Nm_Float32
    IMAPve_g_R0_C3
      data IMAPve_g_R0_C3: category=VALUE, sw-calibration-access=READ-ONLY, type=T_M_Nm_Float32
    IMAPve_g_R0_VR
      data IMAPve_g_R0_VR: category=VALUE, sw-calibration-access=READ-ONLY, type=T_M_Nm_Float32
    IMAPve_d_R0_Q
      data IMAPve_d_R0_Q: category=VALUE, sw-calibration-access=READ-ONLY, type=UInt16
    IMAPve_d_R0_Type
      data IMAPve_d_R0_Type: category=VALUE, sw-calibration-access=READ-ONLY, type=UInt16
    IMAPve_g_R0_Confidence
      data IMAPve_g_R0_Confidence: category=VALUE, sw-calibration-access=READ-ONLY, type=T_M_Nm_Float32
    IMAPve_g_R0_W
      data IMAPve_g_R0_W: category=VALUE, sw-calibration-access=READ-ONLY, type=T_M_Nm_Float32
    IMAPve_g_R0_TLC
      data IMAPve_g_R0_TLC: category=VALUE, sw-calibration-access=READ-ONLY, type=T_M_Nm_Float32
    IMAPve_d_R0_LC
      data IMAPve_d_R0_LC: category=VALUE, sw-calibration-access=READ-ONLY, type=UInt16
    IMAPve_g_L1_C0
      data IMAPve_g_L1_C0: category=VALUE, sw-calibration-access=READ-ONLY, type=T_M_Nm_Float32
    IMAPve_g_L1_C1
      data IMAPve_g_L1_C1: category=VALUE, sw-calibration-access=READ-ONLY, type=T_M_Nm_Float32
    IMAPve_g_L1_C2
      data IMAPve_g_L1_C2: category=VALUE, sw-calibration-access=READ-ONLY, type=T_M_Nm_Float32
    IMAPve_g_L1_C3
      data IMAPve_g_L1_C3: category=VALUE, sw-calibration-access=READ-ONLY, type=T_M_Nm_Float32
    IMAPve_g_L1_VR
      data IMAPve_g_L1_VR: category=VALUE, sw-calibration-access=READ-ONLY, type=T_M_Nm_Float32
    IMAPve_d_L1_Q
      data IMAPve_d_L1_Q: category=VALUE, sw-calibration-access=READ-ONLY, type=UInt16
    IMAPve_d_L1_Type
      data IMAPve_d_L1_Type: category=VALUE, sw-calibration-access=READ-ONLY, type=UInt16
    IMAPve_g_L1_Confidence
      data IMAPve_g_L1_Confidence: category=VALUE, sw-calibration-access=READ-ONLY, type=T_M_Nm_Float32
    IMAPve_g_L1_W
      data IMAPve_g_L1_W: category=VALUE, sw-calibration-access=READ-ONLY, type=T_M_Nm_Float32
    IMAPve_g_L1_TLC
      data IMAPve_g_L1_TLC: category=VALUE, sw-calibration-access=READ-ONLY, type=T_M_Nm_Float32
    IMAPve_d_L1_LC
      data IMAPve_d_L1_LC: category=VALUE, sw-calibration-access=READ-ONLY, type=UInt16
    IMAPve_g_R1_C0
      data IMAPve_g_R1_C0: category=VALUE, sw-calibration-access=READ-ONLY, type=T_M_Nm_Float32
    IMAPve_g_R1_C1
      data IMAPve_g_R1_C1: category=VALUE, sw-calibration-access=READ-ONLY, type=T_M_Nm_Float32
    IMAPve_g_R1_C2
      data IMAPve_g_R1_C2: category=VALUE, sw-calibration-access=READ-ONLY, type=T_M_Nm_Float32
    IMAPve_g_R1_C3
      data IMAPve_g_R1_C3: category=VALUE, sw-calibration-access=READ-ONLY, type=T_M_Nm_Float32
    IMAPve_g_R1_VR
      data IMAPve_g_R1_VR: category=VALUE, sw-calibration-access=READ-ONLY, type=T_M_Nm_Float32
    IMAPve_d_R1_Q
      data IMAPve_d_R1_Q: category=VALUE, sw-calibration-access=READ-ONLY, type=UInt16
    IMAPve_d_R1_Type
      data IMAPve_d_R1_Type: category=VALUE, sw-calibration-access=READ-ONLY, type=UInt16
    IMAPve_g_R1_Confidence
      data IMAPve_g_R1_Confidence: category=VALUE, sw-calibration-access=READ-ONLY, type=T_M_Nm_Float32
    IMAPve_g_R1_W
      data IMAPve_g_R1_W: category=VALUE, sw-calibration-access=READ-ONLY, type=T_M_Nm_Float32
    IMAPve_g_R1_TLC
      data IMAPve_g_R1_TLC: category=VALUE, sw-calibration-access=READ-ONLY, type=T_M_Nm_Float32
    IMAPve_d_R1_LC
      data IMAPve_d_R1_LC: category=VALUE, sw-calibration-access=READ-ONLY, type=UInt16
    IMAPve_d_Camera_Signal_Fault
      data IMAPve_d_Camera_Signal_Fault: category=VALUE, sw-calibration-access=READ-ONLY, type=UInt16
    IMAPve_d_Camera_Status
      data IMAPve_d_Camera_Status: category=VALUE, sw-calibration-access=READ-ONLY, type=UInt16
    LKASve_y_Vehicle_Lane_Display
      data LKASve_y_Vehicle_Lane_Display: category=VALUE, sw-calibration-access=READ-ONLY, type=UInt8
    LKASve_y_LDW_Status_Display
      data LKASve_y_LDW_Status_Display: category=VALUE, sw-calibration-access=READ-ONLY, type=UInt8
    LKASve_y_LKA_Status_Display
      data LKASve_y_LKA_Status_Display: category=VALUE, sw-calibration-access=READ-ONLY, type=UInt8
    LKASve_y_LDW_Flag
      data LKASve_y_LDW_Flag: category=VALUE, sw-calibration-access=READ-ONLY, type=UInt8
    LKASve_y_Hands_Off_Warning
      data LKASve_y_Hands_Off_Warning: category=VALUE, sw-calibration-access=READ-ONLY, type=UInt8
    LKASve_y_LKA_Action_Indication
      data LKASve_y_LKA_Action_Indication: category=VALUE, sw-calibration-access=READ-ONLY, type=UInt8
    LKASve_y_HMI_Popup_Status
      data LKASve_y_HMI_Popup_Status: category=VALUE, sw-calibration-access=READ-ONLY, type=UInt8
    LKASve_y_EPS_State_Control
      data LKASve_y_EPS_State_Control: category=VALUE, sw-calibration-access=READ-ONLY, type=UInt8
    LKASve_g_LKA_SWA_Control
      data LKASve_g_LKA_SWA_Control: category=VALUE, sw-calibration-access=READ-ONLY, type=T_M_Nm_Float32
    LKASve_g_EPS_Factor_Control
      data LKASve_g_EPS_Factor_Control: category=VALUE, sw-calibration-access=READ-ONLY, type=T_M_Nm_Float32
    LKASve_y_EPS_LKA_Control
      data LKASve_y_EPS_LKA_Control: category=VALUE, sw-calibration-access=READ-ONLY, type=UInt8
